## integration-tests/project-folder/sources/meta-error/conf/layer.conf
```bitbake
# We have a conf and classes directory, add to BBPATH
BBPATH .= ":${LAYERDIR}"

# We have a recipes directory, add to BBFILES
BBFILES += "${LAYERDIR}/recipes-*/*/*.bb \
	${LAYERDIR}/recipes-*/*/*.bbappend"

BBFILE_COLLECTIONS += "error"
BBFILE_PATTERN_error := "^${LAYERDIR}/"
BBFILE_PRIORITY_error = "6"

LAYERSERIES_COMPAT_error = "mickledore nanbield scarthgap"

LAYERDEPENDS_error = ""
```

## integration-tests/project-folder/sources/meta-fixtures-versions/conf/layer.conf
```bitbake
# We have a conf and classes directory, add to BBPATH
BBPATH .= ":${LAYERDIR}"

# We have a recipes directory, add to BBFILES
BBFILES += "${LAYERDIR}/recipes-*/*/*.bb \
	${LAYERDIR}/recipes-*/*/*.bbappend"

BBFILE_COLLECTIONS += "fixture-versions"
BBFILE_PATTERN_fixture-versions := "^${LAYERDIR}/"
BBFILE_PRIORITY_fixture-versions = "6"

LAYERSERIES_COMPAT_fixture-versions = "mickledore nanbield"

LAYERDEPENDS_fixture-versions = ""

PREFERRED_VERSION_fixture-version = "0.2.0"
```
